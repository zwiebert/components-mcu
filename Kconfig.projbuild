## Kconfig.projbuild
```kconfig
rsource  "cli/Kconfig"
rsource  "config_kvs/Kconfig"
rsource  "firmware_update/Kconfig"
rsource  "net_http_server/Kconfig"
rsource  "net/Kconfig"
rsource  "net_mqtt_client/Kconfig"
rsource  "stm32/Kconfig"
rsource  "txtio/Kconfig"
rsource  "uout/Kconfig"
rsource  "utils_misc/Kconfig"
rsource  "utils_time/Kconfig"
rsource  "weather/Kconfig"
```

## cli/Kconfig
```kconfig
menu "zwiebert: CLI"

    config UOUT_HAVE_COMPONENT
      bool
      default y

    config CLI_JSON_ROOT_OBJECT
        bool "create a JSON root object before dispatching to cli handlers"
        default y
        help
            Disable this, if you need to send multiple root objects from a cli handler.
            You may send each object terminated with newline to let the receiver get them
            with a getline() function. A root object would prevent that.
            You should disable the assert check for a mandatory root object in UOUT configuration 
            also.

    config CLI_CMDLINE_ALLOW_LF
       bool "allow a line-feed character to terminate a command line"
       default n

    config CLI_INTERACTIVE_CONSOLE
       bool "add human readable messages to the console output"
       default y

    config CLI_DEBUG
        bool "Enable debug messages"
        default n

endmenu
```

## components/config_kvs/Kconfig
```kconfig
menu "zwiebert: config_kvs"

    config APP_MQTT_CLIENT_ID
        string "Default ID of MQTT client"
        default "zb"

    config APP_MQTT_ROOT_TOPIC
        string "Default root topic of MQTT client"
        default "root"

    config APP_MQTT_URL
        string "Default MQTT-server URL"
        default ""

    config APP_MQTT_ENABLE
        bool  "Enable MQTT client by default"
        default n

    config APP_MQTT_USER
        string "Default login name for MQTT server"
        default ""

    config APP_MQTT_PASSWORD
        string "Default login password for MQTT server"
        default ""

    config APP_HTTP_ENABLE
        bool  "Enable HTTP server by default"
        default n

    config APP_HTTP_USER
        string "Default login name for HTTP server"
        default ""

    config APP_HTTP_PASSWORD
        string "Default login password for HTTP server"
        default ""

    config APP_UART_BAUD_RATE
        int "Baud rate of serial interface"
        default 115200

    config APP_NTP_SERVER
        string "Default NTP server"
        default "gateway"

    config APP_WIFI_SSID
        string "Default WIFI/WLAN SSID"
        default ""

    config APP_WIFI_PASSWORD
        string "Default WIFI/WLAN password"
        default ""




endmenu
```

## components/net/Kconfig
```kconfig
menu "zwiebert: Networking"

    config APP_USE_NETWORK
        bool "Activate NETWORK"
        default y

    config APP_USE_LAN
        depends on APP_USE_NETWORK
        bool "Activate LAN"
        default y

    config APP_USE_WLAN
        depends on APP_USE_NETWORK
        bool "Activate WLAN"
        default y

    config APP_WIFI_SSID
        depends on APP_USE_WLAN
        string "Default WIFI/WLAN SSID"
        default ""

    config APP_WIFI_PASSWORD
        depends on APP_USE_WLAN
        string "Default WIFI/WLAN password"
        default ""

    config APP_USE_WLAN_AP
        depends on APP_USE_NETWORK
        bool "Activate WLAN_AP"
        default y

    config APP_USE_AP_FALLBACK
        depends on APP_USE_WLAN_AP
        bool "Activate AP_FALLBACK"
        default y

    config APP_USE_NTP
        depends on APP_USE_NETWORK
        bool "Activate NTP"
        default y

    config APP_NTP_SERVER
        depends on APP_USE_NTP
        string "Default NTP server"
        default "gateway"

    config APP_USE_TCPS
        depends on APP_USE_NETWORK
        bool "Activate TCPS (non task)"
        default n

    config APP_USE_TCPS_TASK
        depends on APP_USE_NETWORK
        bool "Activate TCPS_TASK"
        default y

    config APP_TCPS_ENABLE
        depends on APP_USE_TCPS_TASK
        int  "Enable TCPS server by default"
        range 0 1
        default 1


endmenu
```

## components/net_http_server/Kconfig
```kconfig
menu "zwiebert: HTTP Server"

    config APP_HTTP_ENABLE
        int  "Enable HTTP server by default"
        range 0 1
        default 0

    config APP_HTTP_USER
        string "Default login name for HTTP server"
        default ""

    config APP_HTTP_PASSWORD
        string "Default login password for HTTP server"
        default ""


endmenu
```

## components/net_mqtt/Kconfig
```kconfig
menu "zwiebert: MQTT client"
    
config APP_USE_MQTT
  bool "Activate MQTT"
  default y
    
 endmenu
```

## config_kvs/Kconfig
```kconfig
menu "zwiebert: config_kvs"

    config CONFIG_KVS_HAVE_COMPONENT
      bool
      default y

    config APP_CFG_NAMESPACE
        string "Namespace for kvs settings storage"
        default "Settings"
        help
            Note: When changed, the previous saved settings data will become inacessible

endmenu
```

## firmware_update/Kconfig
```kconfig
menu "zwiebert: Firmware Updater OTA"

    config APP_OTA_USE_CERT_BUNDLE
        bool "Use certificate bundle instead of our own ca_cert.pem"
        default y

endmenu
```

## net/Kconfig
```kconfig
menu "zwiebert: Networking"

    config NET_HAVE_COMPONENT
        bool
        default y

    config APP_USE_LAN
        depends on APP_USE_NETWORK
        bool "Activate LAN"
        default y

    config APP_USE_WLAN
        depends on APP_USE_NETWORK
        bool "Activate WLAN"
        default y

    config APP_WIFI_SSID
        depends on APP_USE_WLAN
        string "Default WIFI/WLAN SSID"
        default ""

    config APP_WIFI_PASSWORD
        depends on APP_USE_WLAN
        string "Default WIFI/WLAN password"
        default ""

    config APP_USE_WLAN_AP
        depends on APP_USE_NETWORK
        bool "Activate WLAN_AP"
        default y

    config APP_USE_AP_FALLBACK
        depends on APP_USE_WLAN_AP
        bool "Activate AP_FALLBACK"
        default y

    config APP_USE_NTP
        depends on APP_USE_NETWORK
        bool "Activate NTP"
        default y

    config APP_NTP_SERVER
        depends on APP_USE_NTP
        string "Default NTP server"
        default "gateway"

    config APP_USE_TCPS
        depends on APP_USE_NETWORK
        bool "Activate TCPS (non task)"
        default n

    config APP_USE_TCPS_TASK
        depends on APP_USE_NETWORK
        bool "Activate TCPS_TASK"
        default y

    config APP_TCPS_ENABLE
        int  "Enable TCP server by default"
        range 0 1
        default 1

    config APP_TCPS_PORT
        int  "TCP server port number"
        default 7777

    config APP_TCPS_PORT_IA
        int  "Interactive TCP server port number"
        default 0

    config APP_TCPS_CONNECTIONS_MAX
        int  "Number of maximal allowed connections to TCP server"
        default -1
        
    config NET_HTTP_CLIENT_DEBUG
        bool "Enable HTTP-client debug messages"
        default n

    config NET_NTP_CLIENT_DEBUG
        bool "Enable NTP-client debug messages"
        default n

    config NET_TCP_CLI_CLIENT_DEBUG
        bool "Enable TCP-CLI-client debug messages"
        default n        
        

endmenu
```

## net_connect/Kconfig
```kconfig
menu "zwiebert: UOUT"

    config NET_CONNECT_HAVE_COMPONENT
      bool
      default y

    config NET_CONNECT_PAUSE_TIMES
      bool "Experimental: Allow user to pause network at certain wall times"
      default n
endmenu
```

## net_mqtt_client/Kconfig
```kconfig
menu "zwiebert: MQTT client"

    config NET_MQTT_CLIENT_HAVE_COMPONENT
        bool
        default y

    config APP_MQTT_CLIENT_ID
        string "Default ID of MQTT client"
        default "zb"

    config APP_MQTT_ROOT_TOPIC
        string "Default root topic of MQTT client"
        default "root"

    config APP_MQTT_URL
        string "Default MQTT-server URL"
        default ""

    config APP_MQTT_ENABLE
        int  "Enable MQTT client by default"
        range 0 1
        default 0

    config APP_MQTT_USER
        string "Default login name for MQTT server"
        default ""

    config APP_MQTT_PASSWORD
        string "Default login password for MQTT server"
        default ""

    config NET_MQTT_CLIENT_DEBUG
        bool "Enable debug messages"
        default n

endmenu
```

## stm32/Kconfig
```kconfig
menu "zwiebert: STM32"

    config STM32_HAVE_COMPONENT
      bool 
      default y

    config STM32_USE_COMPONENT
      bool 
      default y

    config STM32_DEBUG
        bool "Enable stm32 component debug messages"
        default n

    config STM32_MAKE_COMPONENT_THREAD_SAFE
        bool "Make stm32 component generally thread safe"
        default y

    config STM32_MAKE_API_THREAD_SAFE
        depends on STM32_MAKE_COMPONENT_THREAD_SAFE
        bool "Make all stm32 API functions totally thread safe"
        default y

endmenu
```

## txtio/Kconfig
```kconfig
menu "zwiebert: txtio"

    config TXTIO_HAVE_COMPONENT
        bool
        default y

    config APP_UART_BAUD_RATE
        int "Baud rate of serial interface"
        default 115200

endmenu
```

## uout/Kconfig
```kconfig
menu "zwiebert: UOUT"

    config UOUT_HAVE_COMPONENT
      bool
      default y

    config UOUT_PUBLISH_LOG_AS_TXT
        bool "publish log messages (also) as plain text in terminal"
        default n
        help
            We now publish messages in JSON format.  The plain text format is for backwards
            compatibility with old versions for FHEM tronferno_mcu module and Android app

    config UOUT_PUBLISH_IP_ADDR_AS_TXT
        bool "publish IP address (also) as plain text in terminal"
        default y
        help
            We now publish messages in JSON format.  The plain text format is for backwards
            compatibility with old versions for FHEM tronferno_mcu module and Android app     
        
    config UOUT_DEBUG
        bool "Enable debug messages"
        default n

endmenu
```

## utils_misc/Kconfig
```kconfig
menu "zwiebert: UTILS_MISC"
     
    config UTILS_MISC_MUTEX_DEBUG
        bool "Enable debug messages"
        default n

endmenu
```

## utils_time/Kconfig
```kconfig
menu "zwiebert: config_kvs"

    config APP_USE_ESP_GET_TIME
        bool "Get up-time from esp_timer_get_time()"
        default y
        help
            Don't count up-time in our own timer-ISR.
            Use esp_timer_get_time() instead

endmenu
```

## weather/Kconfig
```kconfig
menu "zwiebert: weather"

  config WEATHER_OWM_URL_STRING
    string "OpenWeatherMap URL string"
    default "http://api.openweathermap.org/data/2.5/weather?q=Berlin&APPID=12345678901234567890123456789012"
	  help
	   This URL contains location and API key obtained from 'https://home.openweathermap.org/' site.
		
		You need to set up a free account on this site first.
   
  config WEATHER_TEST_DEBUG
    bool "Enable debug messages"
    default n
    
endmenu
```
